CM_ "manually generated file"

CM_ "starts here"
VERSION ""

NS_ :

BU_: EBCM EON CAM RADAR PCM EPS VSA SCM BDY XXX EPB

BO_ 291 CAM_291: 8 XXX
 SG_ FULL : 7|63@0+ (1,0) [0|268435455] "" XXX

BO_ 767 CAM_767: 8 XXX
 SG_ FULL : 7|63@0+ (1,0) [0|268435455] "" XXX

BO_ 768 CAM_768: 8 XXX
 SG_ FULL : 7|63@0+ (1,0) [0|268435455] "" XXX

BO_ 769 CAM_769: 8 XXX
 SG_ FULL : 7|63@0+ (1,0) [0|268435455] "" XXX

BO_ 771 CAM_771: 8 XXX
 SG_ FULL : 7|63@0+ (1,0) [0|268435455] "" XXX

BO_ 773 CAM_773: 8 XXX
 SG_ FULL : 7|63@0+ (1,0) [0|268435455] "" XXX

BO_ 775 CAM_775: 8 XXX
 SG_ FULL : 7|63@0+ (1,0) [0|268435455] "" XXX

BO_ 777 CAM_777: 8 XXX
 SG_ FULL : 7|63@0+ (1,0) [0|268435455] "" XXX

BO_ 779 CAM_779: 8 XXX
 SG_ FULL : 7|63@0+ (1,0) [0|268435455] "" XXX

BO_ 781 CAM_781: 8 XXX
 SG_ FULL : 7|63@0+ (1,0) [0|268435455] "" XXX

BO_ 783 CAM_783: 8 XXX
 SG_ FULL : 7|63@0+ (1,0) [0|268435455] "" XXX

BO_ 785 CAM_785: 8 XXX
 SG_ FULL : 7|63@0+ (1,0) [0|268435455] "" XXX

BO_ 787 CAM_787: 8 XXX
 SG_ FULL : 7|63@0+ (1,0) [0|268435455] "" XXX

BO_ 789 CAM_789: 8 XXX
 SG_ FULL : 7|63@0+ (1,0) [0|268435455] "" XXX

BO_ 791 CAM_791: 8 XXX
 SG_ FULL : 7|63@0+ (1,0) [0|268435455] "" XXX

BO_ 849 CAM_849: 8 XXX
 SG_ FULL : 7|63@0+ (1,0) [0|268435455] "" XXX

BO_ 864 CAM_864: 8 XXX
 SG_ FULL : 7|63@0+ (1,0) [0|268435455] "" XXX

BO_ 865 CAM_865: 8 XXX
 SG_ FULL : 7|63@0+ (1,0) [0|268435455] "" XXX

BO_ 866 CAM_866: 8 XXX
 SG_ FULL : 7|63@0+ (1,0) [0|268435455] "" XXX

BO_ 1664 CAM_1664: 8 XXX
 SG_ FULL : 7|63@0+ (1,0) [0|268435455] "" XXX

BO_ 1665 CAM_1665: 8 XXX
 SG_ FULL : 7|63@0+ (1,0) [0|268435455] "" XXX

BO_ 1666 CAM_1666: 8 XXX
 SG_ FULL : 7|63@0+ (1,0) [0|268435455] "" XXX

BO_ 1667 CAM_1667: 8 XXX
 SG_ FULL : 7|63@0+ (1,0) [0|268435455] "" XXX

BO_ 1668 CAM_1668: 8 XXX
 SG_ FULL : 7|63@0+ (1,0) [0|268435455] "" XXX

BO_ 1669 CAM_1669: 8 XXX
 SG_ FULL : 7|63@0+ (1,0) [0|268435455] "" XXX
